## sdkconfig.defaults
```kconfig
CONFIG_FREERTOS_HZ=1000
CONFIG_ESPTOOLPY_FLASHSIZE_4MB=y
CONFIG_ESPTOOLPY_FLASHSIZE="4MB"
CONFIG_ESP_CONSOLE_UART_BAUDRATE=921600
CONFIG_ESP_CONSOLE_UART_BAUDRATE_CUSTOM=y
```
